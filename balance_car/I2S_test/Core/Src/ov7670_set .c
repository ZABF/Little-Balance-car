#include <main.h>

uint8_t Reg_set[][2]={
	{0x3a, 0x04},
	{0x40, 0xd0},
	{0x12, 0x14},
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	{0xa2, 0x02},
//	{0x11, 0x81},
	
	{0x7a, 0x20},
	{0x7b, 0x1c},
	{0x7c, 0x28},
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	{0x13, 0xe0},
//	{0x00, 0x00},
	
	{0x10, 0x00},
//	{0x0d, 0x00},
	{0x14, 0x28},
	{0xa5, 0x05},
	{0xab, 0x07},
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	{0x13, 0xe5},

//	{0x0e, 0x61},
	{0x0f, 0x4b},
//	{0x16, 0x02},
	{0x1e, 0x07},
//	{0x21, 0x02},
//	{0x22, 0x91},
//	{0x29, 0x07},
//	{0x33, 0x0b},
//	{0x35, 0x0b},
//	{0x37, 0x1d},
//	{0x38, 0x71},
//	{0x39, 0x2a},
	{0x3c, 0x78},
//	{0x4d, 0x40},
//	{0x4e, 0x20},
	{0x69, 0x00},
	{0x6b, 0x60},
	{0x74, 0x19},
//	{0x8d, 0x4f},
//	{0x8e, 0x00},
//	{0x8f, 0x00},
//	{0x90, 0x00},
//	{0x91, 0x00},
	{0x92, 0x00},
//	{0x96, 0x00},
//	{0x9a, 0x80},
//	{0xb0, 0x84},
	{0xb1, 0x0c},
//	{0xb2, 0x0e},
	{0xb3, 0x82},
//	{0xb8, 0x0a},



//	{0x43, 0x14},
//	{0x44, 0xf0},
//	{0x45, 0x34},
//	{0x46, 0x58},
//	{0x47, 0x28},
//	{0x48, 0x3a},
	{0x59, 0x88},
//	{0x5a, 0x88},
//	{0x5b, 0x44},
//	{0x5c, 0x67},
//	{0x5d, 0x49},
//	{0x5e, 0x0e},
	{0x64, 0x04},
	{0x65, 0x20},
	{0x66, 0x05},
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	{0x3b,0x0a},
/**/	
 };


void init_ov7670reg(void){
	int size=sizeof(Reg_set)/sizeof(Reg_set[0][0])/2;
	uint8_t temp;
	for(int i=0;i<size;i++){
		WR_Reg(Reg_set[i][0],Reg_set[i][1]);
			temp=RD_Reg(Reg_set[i][0]);
			if(temp!=Reg_set[i][1]) printf("[fail_%#x_%#x->%#x] \n",Reg_set[i][0],Reg_set[i][1],temp); 
//			else printf("[success]\n");
	}	
		for(int i=0;i<size;i++){
		temp=RD_Reg(Reg_set[i][0]);
		if(temp!=Reg_set[i][1]) printf("[changed_%#x_%#x->%#x] \n",Reg_set[i][0],Reg_set[i][1],temp); 
//		else printf("[no change]\n");
	}

	
}

void OV7670_Window_Set(uint16_t sx,uint16_t sy,uint16_t width,uint16_t height)
{
	uint16_t endx;
	uint16_t endy;
	uint8_t temp; 
	
	endx=(sx+width*2)%784;	//   sx:HSTART endx:HSTOP    
 	endy=sy+height*2;		//   sy:VSTRT endy:VSTOP		
	
	//设置HREF
	temp=RD_Reg(0X32);				//读取Href之前的值
	temp&=0XC0;
	temp|=((endx&0X07)<<3)|(sx&0X07);	
	WR_Reg(0X32,temp);
	WR_Reg(0X17,sx>>3);			//设置Href的start高8位
	WR_Reg(0X18,endx>>3);			//设置Href的end的高8位

	//设置VREF
	temp=RD_Reg(0X03);				//读取Vref之前的值
	temp&=0XF0;
	temp|=((endy&0X03)<<2)|(sy&0X03);
	WR_Reg(0X03,temp);				//设置Vref的start和end的最低2位
	WR_Reg(0X19,sy>>2);			//设置Vref的start高8位
	WR_Reg(0X1A,endy>>2);			//设置Vref的end的高8位


}

uint8 ov7670_Init(void){
	uint8 temp;
//	uint16 i=0;
	HAL_GPIO_WritePin(GPIOB,GPIO_PIN_14,GPIO_PIN_RESET);
	HAL_Delay(10);
	HAL_GPIO_WritePin(GPIOB,GPIO_PIN_14,GPIO_PIN_SET);
	HAL_Delay(100);
	WR_Reg(0x12,0x80);// scl and sda must be high at the begining	
//	WR_Reg(0x12,0x80);



	temp=RD_Reg(0x0b);
	printf("(ID_1: %#x)\n",temp);
	
	temp=RD_Reg(0x0a); 
	printf("(ID_2: %#x)\n",temp);

	init_ov7670reg();
	
	printf("[DONE]");

   return 0;

}
